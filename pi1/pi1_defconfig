## pi1/pi1_defconfig
```kconfig
BR2_arm=y
BR2_arm1176jzf_s=y
BR2_TOOLCHAIN_BUILDROOT_CXX=y
BR2_GLOBAL_PATCH_DIR=""
BR2_SYSTEM_DHCP="eth0"
BR2_ROOTFS_OVERLAY="../miniMidiOut-src/pi1/rootfs-overlay"
BR2_ROOTFS_POST_BUILD_SCRIPT="../miniMidiOut-src/pi1/post-build.sh"
BR2_ROOTFS_POST_IMAGE_SCRIPT="../miniMidiOut-src/pi1/post-image.sh"

BR2_LINUX_KERNEL=y
BR2_LINUX_KERNEL_LATEST_CIP_RT_VERSION=y
BR2_LINUX_KERNEL_VERSION="5.10.162-cip24-rt10"
BR2_LINUX_KERNEL_DEFCONFIG="bcm2835"
BR2_LINUX_KERNEL_DTS_SUPPORT=y
BR2_LINUX_KERNEL_INTREE_DTS_NAME="bcm2835-rpi-b-rev2 bcm2835-rpi-b bcm2835-rpi-b-plus bcm2835-rpi-zero"
BR2_LINUX_KERNEL_NEEDS_HOST_OPENSSL=y

BR2_PACKAGE_BUSYBOX_SHOW_OTHERS=y
BR2_PACKAGE_XZ=y
BR2_PACKAGE_RPI_FIRMWARE=y
BR2_PACKAGE_RPI_FIRMWARE_BOOTCODE_BIN=y
BR2_PACKAGE_RPI_FIRMWARE_VARIANT_PI=y
BR2_PACKAGE_RPI_FIRMWARE_CONFIG_FILE="../miniMidiOut-src/pi1/config.txt"
BR2_PACKAGE_RPI_FIRMWARE_CMDLINE_FILE="../miniMidiOut-src/pi1/cmdline.txt"
BR2_PACKAGE_RPI_FIRMWARE_INSTALL_DTB_OVERLAYS=y
BR2_PACKAGE_KMOD=y
BR2_PACKAGE_KMOD_TOOLS=y

BR2_TARGET_ROOTFS_EXT2=y
BR2_TARGET_ROOTFS_EXT2_4=y
BR2_TARGET_ROOTFS_EXT2_SIZE="120M"
BR2_TARGET_ROOTFS_CPIO=y
BR2_TARGET_ROOTFS_CPIO_FULL=y
BR2_TARGET_ROOTFS_CPIO_GZIP=y
BR2_PACKAGE_HOST_DOSFSTOOLS=y
BR2_PACKAGE_HOST_GENIMAGE=y
BR2_PACKAGE_HOST_KMOD_XZ=y
BR2_PACKAGE_HOST_MTOOLS=y

BR2_PACKAGE_MINIMIDIOUT=y
BR2_PACKAGE_ALSA_UTILS=y
BR2_PACKAGE_ALSA_UTILS_ALSACTL=y
BR2_PACKAGE_ALSA_UTILS_ALSAMIXER=y
BR2_PACKAGE_ALSA_UTILS_AMIDI=y
BR2_PACKAGE_ALSA_UTILS_AMIXER=y
BR2_PACKAGE_ALSA_UTILS_APLAY=y
BR2_PACKAGE_ALSA_UTILS_ASEQDUMP=y

BR2_PACKAGE_PORTAUDIO=y
BR2_PACKAGE_PORTAUDIO_ALSA=y
BR2_PACKAGE_PORTAUDIO_OSS=y

BR2_PACKAGE_ALSA_LIB=y
BR2_PACKAGE_ALSA_LIB_DEVDIR="/dev/snd"
BR2_PACKAGE_ALSA_LIB_PCM_PLUGINS="all"
BR2_PACKAGE_ALSA_LIB_CTL_PLUGINS="all"
BR2_PACKAGE_ALSA_LIB_ALOAD=y
BR2_PACKAGE_ALSA_LIB_MIXER=y
BR2_PACKAGE_ALSA_LIB_PCM=y
BR2_PACKAGE_ALSA_LIB_RAWMIDI=y
BR2_PACKAGE_ALSA_LIB_HWDEP=y
BR2_PACKAGE_ALSA_LIB_SEQ=y
BR2_PACKAGE_ALSA_LIB_UCM=y
BR2_PACKAGE_ALSA_LIB_ALISP=y
BR2_PACKAGE_ALSA_LIB_OLD_SYMBOLS=y
BR2_PACKAGE_ALSA_LIB_TOPOLOGY=y
BR2_PACKAGE_ALSA_PLUGINS=y

BR2_PACKAGE_EVTEST=y
BR2_PACKAGE_FLASHROM_ARCH_SUPPORTS=y
```

## pkg/Config.in
```kconfig
config BR2_PACKAGE_MINIMIDIOUT
	bool "miniMidiOut"
	select BR2_PACKAGE_PORTAUDIO
	select BR2_PACKAGE_ALSA_LIB
	select BR2_PACKAGE_ALSA_UTILS
	select BR2_PACKAGE_PORTAUDIO_ALSA
	select BR2_PACKAGE_PORTAUDIO_OSS
	select BR2_PACKAGE_ALSA_UTILS_AMIDI
	select BR2_PACKAGE_ALSA_UTILS_AMIXER
	select BR2_PACKAGE_ALSA_UTILS_ASEQDUMP
	select BR2_PACKAGE_ALSA_PLUGINS
	help
		A CLI midi synthesizer.
```
